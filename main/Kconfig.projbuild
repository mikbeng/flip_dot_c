## main/Kconfig.projbuild
```kconfig
# put here your custom config value
menu "Example Configuration"
config ESP_WIFI_SSID
    string "WiFi SSID"
    default "myssid"
    help
	SSID (network name) for the example to connect to.

config ESP_WIFI_PASSWORD
    string "WiFi Password"
    default "mypassword"
    help
	WiFi password (WPA or WPA2) for the example to use.

config CLOCK_TIMEZONE
    string "POSIX TZ string for clock display"
    default "UTC0"
    help
	Timezone used when rendering the clock (POSIX TZ format).
	Example for Sweden: CET-1CEST,M3.5.0,M10.5.0/3

config OTA_HTTP_PORT
    int "OTA HTTP server port"
    range 1 65535
    default 8080
    help
	TCP port for the HTTP OTA upload server (POST /ota).
	Reachable on the STA network only.

config OTA_PASSWORD
    string "OTA Bearer token"
    default "flipdot-ota"
    help
	Shared secret sent as: Authorization: Bearer <token>
	Change this before using OTA on anything other than a lab LAN.

config OTA_HOSTNAME
    string "STA / mDNS hostname"
    default "flipdot"
    help
	Netif hostname and mDNS name. After STA gets an IP, the OTA
	endpoint is http://<hostname>.local:<port>/ota on networks
	with working mDNS.
endmenu
```
